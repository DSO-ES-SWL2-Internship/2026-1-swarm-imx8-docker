## yocto-builds/build_fsl-imx-xwayland/conf/local.conf
```bitbake
DISTRO ?= 'fsl-imx-xwayland'
MACHINE ??= 'imx8mpevk'
USER_CLASSES ?= "buildstats"
PATCHRESOLVE = "noop"
BB_DISKMON_DIRS ??= "\
    STOPTASKS,${TMPDIR},1G,100K \
    STOPTASKS,${DL_DIR},1G,100K \
    STOPTASKS,${SSTATE_DIR},1G,100K \
    STOPTASKS,/tmp,100M,100K \
    HALT,${TMPDIR},100M,1K \
    HALT,${DL_DIR},100M,1K \
    HALT,${SSTATE_DIR},100M,1K \
    HALT,/tmp,10M,1K"
CONF_VERSION = "2"

DL_DIR ?= "${BSPDIR}/downloads/"
ACCEPT_FSL_EULA = "1"

# Switch to Debian packaging and include package-management in the image
PACKAGE_CLASSES = "package_deb"
EXTRA_IMAGE_FEATURES += "package-management"

# Install SSH server onto image
EXTRA_IMAGE_FEATURES += "ssh-server-openssh"

# Fall back to Yocto's official mirror when a primary upstream URL is unreachable
SOURCE_MIRROR_URL = "http://downloads.yoctoproject.org/mirror/sources/"
INHERIT += "own-mirrors"

# Install additional packages onto image
IMAGE_INSTALL:append = " vim gdbserver"
IMAGE_INSTALL:append = " tensorflow-lite tensorflow-lite-vx-delegate"

# Connectivity packages
IMAGE_INSTALL:append = " kernel-module-nxp-wlan linux-firmware-nxp8997-sdio linux-firmware-pcie8997 wpa-supplicant" 
IMAGE_INSTALL:append = " kernel-module-mwifiex kernel-module-mwifiex-pcie" 
KERNEL_MODULE_AUTOLOAD += "mwifiex_pcie"
IMAGE_INSTALL:append = " net-tools"

BB_NUMBER_THREADS = "4"
PARALLEL_MAKE = "-j 2 -l 2"
PARALLEL_MAKEINST = "-j 2"
```
